## external/Config.in
```kconfig
source "$BR2_EXTERNAL_MOBIX_PATH/package/pappl/Config.in"
source "$BR2_EXTERNAL_MOBIX_PATH/package/lprint/Config.in"
source "$BR2_EXTERNAL_MOBIX_PATH/package/mobix-app/Config.in"
source "$BR2_EXTERNAL_MOBIX_PATH/package/typst/Config.in"
```

## external/configs/mobix_pi0w_defconfig
```kconfig
BR2_arm=y
BR2_arm1176jzf_s=y
BR2_TOOLCHAIN_EXTERNAL=y
BR2_TOOLCHAIN_EXTERNAL_BOOTLIN_ARMV6_EABIHF_GLIBC_STABLE=y
BR2_TIME_BITS_64=y
BR2_PACKAGE_OVERRIDE_FILE="$(BR2_EXTERNAL_MOBIX_PATH)/../local.mk"
BR2_GLOBAL_PATCH_DIR="board/raspberrypi/patches $(BR2_EXTERNAL_MOBIX_PATH)/patches"
BR2_TARGET_GENERIC_HOSTNAME="mobix"
BR2_TARGET_GENERIC_ISSUE="Welcome to mobix"
BR2_ROOTFS_DEVICE_CREATION_DYNAMIC_MDEV=y
BR2_SYSTEM_DHCP=""
BR2_ROOTFS_OVERLAY="$(BR2_EXTERNAL_MOBIX_PATH)/board/pi0w/rootfs-overlay"
BR2_ROOTFS_POST_BUILD_SCRIPT="$(BR2_EXTERNAL_MOBIX_PATH)/board/pi0w/post-build.sh"
BR2_ROOTFS_POST_IMAGE_SCRIPT="$(BR2_EXTERNAL_MOBIX_PATH)/board/pi0w/post-image.sh"
BR2_LINUX_KERNEL=y
BR2_LINUX_KERNEL_CUSTOM_TARBALL=y
BR2_LINUX_KERNEL_CUSTOM_TARBALL_LOCATION="$(call github,raspberrypi,linux,21b410140c47ffab5668399f6f143c7d7b935c8b)/linux-21b410140c47ffab5668399f6f143c7d7b935c8b.tar.gz"
BR2_LINUX_KERNEL_DEFCONFIG="bcmrpi"
BR2_LINUX_KERNEL_LZ4=y
BR2_LINUX_KERNEL_CONFIG_FRAGMENT_FILES="$(BR2_EXTERNAL_MOBIX_PATH)/board/pi0w/linux.fragment"
BR2_LINUX_KERNEL_DTS_SUPPORT=y
BR2_LINUX_KERNEL_INTREE_DTS_NAME="broadcom/bcm2708-rpi-zero-w"
BR2_LINUX_KERNEL_NEEDS_HOST_OPENSSL=y
BR2_PACKAGE_BUSYBOX_CONFIG_FRAGMENT_FILES="$(BR2_EXTERNAL_MOBIX_PATH)/board/pi0w/busybox.fragment"
BR2_PACKAGE_BUSYBOX_SHOW_OTHERS=y
BR2_PACKAGE_BRCMFMAC_SDIO_FIRMWARE_RPI=y
BR2_PACKAGE_BRCMFMAC_SDIO_FIRMWARE_RPI_WIFI=y
BR2_PACKAGE_RPI_FIRMWARE=y
BR2_PACKAGE_RPI_FIRMWARE_BOOTCODE_BIN=y
BR2_PACKAGE_RPI_FIRMWARE_VARIANT_PI_CD=y
BR2_PACKAGE_RPI_FIRMWARE_CONFIG_FILE="$(BR2_EXTERNAL_MOBIX_PATH)/board/pi0w/config.txt"
BR2_PACKAGE_RPI_FIRMWARE_CMDLINE_FILE="$(BR2_EXTERNAL_MOBIX_PATH)/board/pi0w/cmdline.txt"
BR2_PACKAGE_WIRELESS_REGDB=y
BR2_PACKAGE_KMOD=y
BR2_PACKAGE_KMOD_TOOLS=y
BR2_PACKAGE_CA_CERTIFICATES=y
BR2_PACKAGE_OPENSSL=y
BR2_PACKAGE_AVAHI=y
BR2_PACKAGE_AVAHI_DAEMON=y
BR2_PACKAGE_AVAHI_LIBAVAHI_CLIENT=y
BR2_PACKAGE_DBUS=y
BR2_PACKAGE_DHCPCD=y
BR2_PACKAGE_DROPBEAR=y
# BR2_PACKAGE_IFUPDOWN_SCRIPTS is not set
BR2_PACKAGE_IW=y
BR2_PACKAGE_WPA_SUPPLICANT=y
BR2_PACKAGE_WPA_SUPPLICANT_AUTOSCAN=y
BR2_PACKAGE_WPA_SUPPLICANT_CTRL_IFACE=y
BR2_PACKAGE_WPA_SUPPLICANT_CLI=y
BR2_PACKAGE_WPA_SUPPLICANT_PASSPHRASE=y
BR2_PACKAGE_HOST_RUSTC=y
BR2_TARGET_ROOTFS_CPIO=y
BR2_TARGET_ROOTFS_CPIO_LZ4=y
# BR2_TARGET_ROOTFS_TAR is not set
BR2_PACKAGE_HOST_DOSFSTOOLS=y
BR2_PACKAGE_HOST_GENIMAGE=y
BR2_PACKAGE_HOST_KMOD_XZ=y
BR2_PACKAGE_HOST_MTOOLS=y
BR2_PACKAGE_PAPPL=y
BR2_PACKAGE_LPRINT=y
BR2_PACKAGE_TYPST=y
```

## external/package/lprint/Config.in
```kconfig
config BR2_PACKAGE_LPRINT
	bool "lprint"
	depends on BR2_PACKAGE_PAPPL
	help
	  LPrint implements printing for a variety of common label and
	  receipt printers connected via network or USB.

	  https://www.msweet.org/lprint
```

## external/package/mobix-app/Config.in
```kconfig
config BR2_PACKAGE_MOBIX_APP
	bool "mobix-app"
	depends on BR2_PACKAGE_HOST_RUSTC_TARGET_ARCH_SUPPORTS
	depends on BR2_PACKAGE_LPRINT
	select BR2_PACKAGE_HOST_RUSTC
	select BR2_PACKAGE_OPENSSL
	select BR2_PACKAGE_TYPST # runtime
	help
	  The mobix Rust application (app/ in this repository): prints
	  MQTT messages with Typst on the LPrint receipt printer.
	  Supervised by BusyBox init (respawn).

comment "mobix-app needs a toolchain supported by Rust"
	depends on !BR2_PACKAGE_HOST_RUSTC_TARGET_ARCH_SUPPORTS

comment "mobix-app needs lprint"
	depends on BR2_PACKAGE_HOST_RUSTC_TARGET_ARCH_SUPPORTS
	depends on !BR2_PACKAGE_LPRINT
```

## external/package/pappl/Config.in
```kconfig
config BR2_PACKAGE_PAPPL
	bool "pappl"
	depends on BR2_INSTALL_LIBSTDCPP # cups
	depends on BR2_TOOLCHAIN_HAS_THREADS
	depends on BR2_TOOLCHAIN_GCC_AT_LEAST_4_9 # libusb
	depends on BR2_USE_MMU
	depends on !BR2_STATIC_LIBS
	select BR2_PACKAGE_CUPS
	select BR2_PACKAGE_LIBUSB
	select BR2_PACKAGE_LIBPNG
	select BR2_PACKAGE_JPEG
	select BR2_PACKAGE_OPENSSL
	select BR2_PACKAGE_ZLIB
	help
	  PAPPL is a simple C-based framework/library for developing
	  CUPS Printer Applications.

	  https://www.msweet.org/pappl
```

## external/package/typst/Config.in
```kconfig
config BR2_PACKAGE_TYPST
	bool "typst"
	depends on BR2_PACKAGE_HOST_RUSTC_TARGET_ARCH_SUPPORTS
	select BR2_PACKAGE_HOST_RUSTC
	select BR2_PACKAGE_OPENSSL
	help
	  Typst is a markup-based typesetting system. The command line
	  compiler renders .typ files to PDF, PNG or SVG.

	  https://typst.app
```
